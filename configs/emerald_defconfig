## configs/emerald_defconfig
```kconfig
CONFIG_ARM=y
CONFIG_SYS_BOARD="emerald"
CONFIG_ARCH_MEDIATEK=y
CONFIG_TEXT_BASE=0x40000000
CONFIG_SYS_LOAD_ADDR=0x44000000
CONFIG_HAS_CUSTOM_SYS_INIT_SP_ADDR=y
CONFIG_CUSTOM_SYS_INIT_SP_ADDR=0x4c000000
CONFIG_NR_DRAM_BANKS=1
CONFIG_DEFAULT_DEVICE_TREE="mt6789-xiaomi-emerald"
CONFIG_TARGET_MT6789=y
CONFIG_IDENT_STRING="mt6789-emerald"
CONFIG_BAUDRATE=921600
CONFIG_DM_SERIAL=y
CONFIG_MTK_SERIAL=y
```
