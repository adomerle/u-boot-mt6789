// SPDX-License-Identifier: GPL-2.0
/*
 * Copyright (c) 2024 Arseniy Velikanov
 */

/dts-v1/;

#include "mt6789.dtsi"
/ {
    model = "Xiaomi Redmi Note 13 Pro 4g";
    compatible = "xiaomi,emerald", "mediatek,mt6789";
    chassis-type = "handset";

    chosen {
        #address-cells = <2>;
        #size-cells = <2>;
        ranges;

        simplefb: framebuffer@fe0d0000 {
			compatible = "simple-framebuffer";
			reg = <0x0 0xfe0d0000 0x0 (1080 * 2400 * 4)>;
			width = <1080>;
			height = <2400>;
			stride = <(1080 * 4)>;
			format = "a8r8g8b8";
		};
    };

    // DDR 8GB
    memory@40000000 {
		device_type = "memory";
		reg = <0 0x40000000 0 0x20000000>;
	};
};